/* Copyright (c) 2015, The Linux Foundation. All rights reserved.
 *
 * This program is free software; you can redistribute it and/or modify
 * it under the terms of the GNU General Public License version 2 and
 * only version 2 as published by the Free Software Foundation.
 *
 * This program is distributed in the hope that it will be useful,
 * but WITHOUT ANY WARRANTY; without even the implied warranty of
 * MERCHANTABILITY or FITNESS FOR A PARTICULAR PURPOSE.  See the
 * GNU General Public License for more details.
 */

&mdss_mdp {
	dsi_booyi_hx8399c_1080_vid: qcom,mdss_dsi_booyi_hx8399c_1080p_video {
		qcom,mdss-dsi-panel-name = "booyi HX8399C 1080p video mode dsi panel";
		qcom,mdss-dsi-panel-type = "dsi_video_mode";
		qcom,cont-splash-enabled;
		qcom,mdss-dsi-panel-framerate = <56>;
		qcom,mdss-dsi-virtual-channel-id = <0>;
		qcom,mdss-dsi-stream = <0>;
		qcom,mdss-dsi-panel-width = <1080>;
		qcom,mdss-dsi-panel-height = <1920>;
		qcom,mdss-dsi-h-front-porch = <65>;
		qcom,mdss-dsi-h-back-porch = <81>;
		qcom,mdss-dsi-h-pulse-width = <60>;
		qcom,mdss-dsi-h-sync-skew = <0>;
		qcom,mdss-dsi-v-front-porch = <32>;
		qcom,mdss-dsi-v-back-porch = <26>;
		qcom,mdss-dsi-v-pulse-width = <4>;
		qcom,mdss-dsi-h-left-border = <0>;
		qcom,mdss-dsi-h-right-border = <0>;
		qcom,mdss-dsi-v-top-border = <0>;
		qcom,mdss-dsi-v-bottom-border = <0>;
		qcom,mdss-dsi-bpp = <24>;
		qcom,mdss-dsi-underflow-color = <0xff>;
		qcom,mdss-dsi-border-color = <0>;
		qcom,mdss-dsi-h-sync-pulse = <0>;
		qcom,mdss-dsi-traffic-mode = "burst_mode";
		qcom,mdss-dsi-bllp-eof-power-mode;
		qcom,mdss-dsi-bllp-power-mode;
		qcom,mdss-dsi-lane-0-state;
		qcom,mdss-dsi-lane-1-state;
		qcom,mdss-dsi-lane-2-state;
		qcom,mdss-dsi-lane-3-state;
		qcom,mdss-dsi-panel-timings = [e2 36 24 00 66 6a 28 38 2a 03 04 00];
		qcom,mdss-dsi-t-clk-post = <0x02>;
		qcom,mdss-dsi-t-clk-pre = <0x2a>;
		qcom,mdss-dsi-bl-min-level = <2>;
		qcom,mdss-dsi-bl-max-level = <255>;
		qcom,mdss-pan-physical-width-dimension = <62>;
		qcom,mdss-pan-physical-height-dimension = <111>;
		qcom,mdss-dsi-dma-trigger = "trigger_sw";
		qcom,mdss-dsi-mdp-trigger = "none";
		qcom,mdss-dsi-on-command = [
			29 01 00 00 00 00 04
			B9 FF 83 99
			29 01 00 00 00 00 05
			Ba 63 03 68 63
			29 01 00 00 00 00 10
			B1 02 04 6A 8A 01 32
			33 11 11 4D 4D 56 73
			02 02
			29 01 00 00 0A 00 10
			B2 00 80 80 AE 05 07
			5A 11 10 10 00 1E 70
			03 D4
			29 01 00 00 00 00 2d
			B4 00 FF 10 18 04 9A
			00 00 06 00 02 04 00
			24 02 04 0A 26 03 00
			00 00 FF 00 10 18 04
			9A 00 00 08 00 02 04
			00 24 02 04 0A 00 00
			02 9F 00
			29 01 00 00 00 00 22
			D3 00 0d 00 00 00 00
			30 00 00 00 05 00 05
			00 07 88 07 88 00 00
			00 00 00 15 00 00 00
			01 00 00 00 05 40
			29 01 00 00 00 00 21
			D5 20 20 19 19 18 18
			01 01 00 00 25 25 18
			18 18 18 24 24 18 18
			18 18 18 18 18 18 2F
			2F 30 30 31 31
			29 01 00 00 00 00 21
			D6 24 24 18 18 19 19
			00 00 01 01 25 25 18
			18 18 18 20 20 18 18
			18 18 18 18 18 18 2F
			2F 30 30 31 31
			29 01 00 00 00 00 02
			BD 00
			29 01 00 00 00 00 11
			D8 AA 8A AA AA AA 8A
			AA AA AA 8A AA AA AA
			8A AA AA
			29 01 00 00 00 00 02
			BD 01
			29 01 00 00 00 00 11
			D8 FF FC C0 3F FF FC
			C0 3F FF FC C0 3F FF
			FC C0 3F
			29 01 00 00 00 00 02
			BD 02
			29 01 00 00 00 00 09
			D8 FF FC C0 3F FF FC
			C0 3F
			29 01 00 00 00 00 02
			BD 00
			29 01 00 00 00 00 37
			E0 07 18 21 1C 40 49
			56 53 5C 67 70 78 7C
			84 8C 91 96 9D 9E A5
			98 A6 A8 55 4E 52 53
			07 18 21 1C 40 49 56
			53 5C 67 70 78 7C 84
			8C 91 96 9D 9E A5 98
			A6 A8 55 4E 52 53
			29 01 00 00 00 00 03
			B6 82 82
			29 01 00 00 00 00 02
			CC 00
			29 01 00 00 00 00 02
			36 02
			05 01 00 00 78 00 02
			11 00
			05 01 00 00 32 00 02
			29 00
		];
		qcom,mdss-dsi-off-command = [
			05 01 00 00 32 00 02
			28 00
			05 01 00 00 64 00 02
			10 00
			29 01 00 00 00 00 04
			B9 ff 83 99
			29 01 00 00 00 00 02
			b1 01
		];

		qcom,mdss-dsi-on-command-state = "dsi_lp_mode";
		qcom,mdss-dsi-off-command-state = "dsi_lp_mode";

		qcom,mdss-dsi-bl-pmic-control-type = "bl_ctrl_pwm";
		qcom,mdss-dsi-bl-pmic-pwm-frequency = <100>;
		qcom,mdss-dsi-bl-pmic-bank-select = <0>;
		qcom,mdss-dsi-pwm-gpio = <&pm8950_mpps 4 0>;
		qcom,mdss-dsi-reset-sequence = <1 20>, <0 10>, <1 50>;
		qcom,mdss-dsi-lp11-init;
		qcom,mdss-dsi-tx-eot-append;
		qcom,panel-supply-entries = <&dsi_panel_pwr_supply>;

		qcom,mdss-dsi-panel-status-command = [06 01 00 01 05 00 02 09 08];
		qcom,mdss-dsi-panel-status-command-state = "dsi_lp_mode";
		qcom,mdss-dsi-panel-status-check-mode = "reg_read";
		qcom,mdss-dsi-panel-status-value = <0x81 0x73 0x04>;
		qcom,mdss-dsi-panel-status-read-length = <3>;
		qcom,esd-check-enabled;
	};
};
