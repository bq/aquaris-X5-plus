/* Copyright (c) 2015, The Linux Foundation. All rights reserved.
 *
 * This program is free software; you can redistribute it and/or modify
 * it under the terms of the GNU General Public License version 2 and
 * only version 2 as published by the Free Software Foundation.
 *
 * This program is distributed in the hope that it will be useful,
 * but WITHOUT ANY WARRANTY; without even the implied warranty of
 * MERCHANTABILITY or FITNESS FOR A PARTICULAR PURPOSE.  See the
 * GNU General Public License for more details.
 */

&mdss_mdp {
	dsi_booyi_hx8399b_1080_vid: qcom,mdss_dsi_booyi_hx8399b_1080p_command {
		qcom,mdss-dsi-panel-name = "booyi HX8399B 1080p command mode dsi panel";
		qcom,mdss-dsi-panel-type = "dsi_video_mode";
		qcom,cont-splash-enabled;
		qcom,mdss-dsi-panel-framerate = <60>;
		qcom,mdss-dsi-virtual-channel-id = <0>;
		qcom,mdss-dsi-stream = <0>;
		qcom,mdss-dsi-panel-width = <1080>;
		qcom,mdss-dsi-panel-height = <1920>;
		qcom,mdss-dsi-h-front-porch = <90>;
		qcom,mdss-dsi-h-back-porch = <60>;
		qcom,mdss-dsi-h-pulse-width = <20>;
		qcom,mdss-dsi-h-sync-skew = <0>;
		qcom,mdss-dsi-v-front-porch = <8>;
		qcom,mdss-dsi-v-back-porch = <10>;
		qcom,mdss-dsi-v-pulse-width = <2>;
		qcom,mdss-dsi-h-left-border = <0>;
		qcom,mdss-dsi-h-right-border = <0>;
		qcom,mdss-dsi-v-top-border = <0>;
		qcom,mdss-dsi-v-bottom-border = <0>;
		qcom,mdss-dsi-bpp = <24>;
		qcom,mdss-dsi-underflow-color = <0xff>;
		qcom,mdss-dsi-border-color = <0>;
		qcom,mdss-dsi-h-sync-pulse = <0>;
		qcom,mdss-dsi-traffic-mode = "burst_mode";
		qcom,mdss-dsi-bllp-eof-power-mode;
		qcom,mdss-dsi-bllp-power-mode;
		qcom,mdss-dsi-lane-0-state;
		qcom,mdss-dsi-lane-1-state;
		qcom,mdss-dsi-lane-2-state;
		qcom,mdss-dsi-lane-3-state;
		qcom,mdss-dsi-panel-timings = [e7 36 24 00 66 6a 2a 3a 2d 03 04 00];
		qcom,mdss-dsi-t-clk-post = <0x03>;
		qcom,mdss-dsi-t-clk-pre = <0x2b>;
		qcom,mdss-dsi-bl-min-level = <10>;
		qcom,mdss-dsi-bl-max-level = <255>;
		qcom,mdss-pan-physical-width-dimension = <62>;
		qcom,mdss-pan-physical-height-dimension = <111>;
		qcom,mdss-dsi-dma-trigger = "trigger_sw";
		qcom,mdss-dsi-mdp-trigger = "none";
		qcom,mdss-dsi-on-command = [
			39 01 00 00 00 00 04
			B9 FF 83 99

			39 01 00 00 00 00 0c
			B1 18 AC 8C 11 D1 23
			33 11 F1 9E 63

			39 01 00 00 00 00 19
			B2 00 80 00 7F 05 07
			62 4D 11 11 00 1C 41
			00 00 08 1C 0B 62 00
			09 DB DB 24

			39 01 00 00 00 00 2d
			B4 00 FF 05 B7 59 59
			05 B7 00 00 0E 00 00
			04 00 2A 05 05 0B 00
			33 0E B0 05 B7 59 59
			05 B7 00 00 0E 00 00
			04 00 2A 05 05 0B 00
			03 0E B0

			39 01 00 00 00 00 25
			D3 00 02 00 00 00 00
			10 00 00 07 88 07 88
			00 07 88 07 88 00 00
			05 00 05 08 11 06 06
			01 00 00 00 05 08 00
			00 4A

			39 01 00 00 00 00 21
			D5 28 28 1E 1E 1F 1F
			01 01 00 00 24 24 18
			18 18 18 20 20 18 18
			18 18 18 18 18 18 2F
			2F 30 30 31 31

			39 01 00 00 00 00 21
			D6 20 20 1E 1E 1F 1F
			00 00 01 01 24 24 18
			18 18 18 28 28 18 18
			18 18 18 18 18 18 2F
			2F 30 30 31 31

			39 01 00 00 00 00 31
			D8 AA BA AA AA AA BA
			AA AA AA AA AA AA AA
			AA AA AA 00 0A 2A 80
			00 0A 2A 80 82 CA AA
			AA 82 CA AA AA 00 00
			00 00 00 00 00 00 FF
			FF EA BF FF FF EA BF

			39 01 00 00 00 00 02
			CC 08

			39 01 00 00 00 00 02
			BC 34

			39 01 00 00 00 00 02
			C2 13

			39 01 00 00 00 00 2b
			E0 1B 24 26 2a 2d 35
			25 42 06 0B 0F 12 14
			12 13 13 18 09 16 08
			15 1B 24 26 2a 2d 35
			25 42 06 0B 0F 12 14
			12 13 13 18 09 16 08
			15

			39 01 00 00 00 00 02
			BD 00

			39 01 00 00 00 00 2c
			C1 01 00 08 10 17 1F
			26 2E 36 3F 46 4E 56
			5E 66 6E 77 7F 87 8F
			98 A0 A7 B0 B7 BF C7
			CF D7 DE E6 EF F7 FF
			03 BF 7A FC 04 33 65
			F4 C0

			39 01 00 00 00 00 02
			BD 01

			39 01 00 00 00 00 2b
			C1 00 07 0F 16 1E 25
			2C 34 3C 43 4A 52 5A
			62 69 71 79 81 88 90
			99 A0 A8 B0 B7 BE C6
			CE D5 DC E4 EC F4 3A
			1C 7E 8E 4F 20 64 65
			00

			39 01 00 00 00 00 02
			BD 02

			39 01 00 00 00 00 2b
			C1 00 07 0E 15 1C 23
			2A 31 39 40 47 4E 56
			5D 65 6C 73 7B 82 8A
			91 99 A0 A7 AF B6 BD
			C4 CC D3 DA E1 E8 1E
			BF BF 61 D8 EF A6 41
			C0

			39 01 00 00 00 00 02
			35 00

			39 01 00 00 00 00 03
			B6 18 18

			05 01 00 00 78 00 02
			11 00
			05 01 00 00 00 00 02
			29 00
		];
		qcom,mdss-dsi-off-command = [
			05 01 00 00 32 00 02
			28 00
			05 01 00 00 10 00 02
			10 00
		];
		qcom,mdss-dsi-on-command-state = "dsi_lp_mode";
		qcom,mdss-dsi-off-command-state = "dsi_lp_mode";
		/*//cmd mode : set TE
		qcom,mdss-dsi-te-pin-select = <1>;
		qcom,mdss-dsi-te-dcs-command = <1>;
		qcom,mdss-dsi-te-check-enable;
		qcom,mdss-dsi-te-using-te-pin;*/
		qcom,mdss-dsi-bl-pmic-control-type = "bl_ctrl_pwm";
		qcom,mdss-dsi-bl-pmic-pwm-frequency = <100>;
		qcom,mdss-dsi-bl-pmic-bank-select = <0>;
		qcom,mdss-dsi-pwm-gpio = <&pm8950_mpps 4 0>;
		qcom,mdss-dsi-reset-sequence = <1 20>, <0 10>, <1 20>;
		qcom,mdss-dsi-tx-eot-append;
		qcom,panel-supply-entries = <&dsi_panel_pwr_supply>;

		//add esd
		qcom,mdss-dsi-panel-status-command = [06 01 00 01 05 00 02 09 08];
		qcom,mdss-dsi-panel-status-command-state = "dsi_hs_mode";
		qcom,mdss-dsi-panel-status-check-mode = "reg_read";
		qcom,mdss-dsi-panel-status-value = <0x80 0x73 0x06>;
		qcom,mdss-dsi-panel-status-read-length = <3>;
		qcom,esd-check-enabled;
	};
};
