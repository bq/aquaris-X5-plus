/* Copyright (c) 2013-2015, The Linux Foundation. All rights reserved.
 *
 * This program is free software; you can redistribute it and/or modify
 * it under the terms of the GNU General Public License version 2 and
 * only version 2 as published by the Free Software Foundation.
 *
 * This program is distributed in the hope that it will be useful,
 * but WITHOUT ANY WARRANTY; without even the implied warranty of
 * MERCHANTABILITY or FITNESS FOR A PARTICULAR PURPOSE.  See the
 * GNU General Public License for more details.
 */

/*---------------------------------------------------------------------------
 * This file is autogenerated file using gcdb parser. Please do not edit it.
 * Update input XML file to add a new entry or update variable in this file
 * VERSION = "1.0"
 *---------------------------------------------------------------------------*/
&mdss_mdp {
	dsi_truly_nt35695_1080_vid: qcom,mdss_dsi_truly_nt35695_1080p_command {
		qcom,mdss-dsi-panel-name = "truly NT35695 1080p command mode dsi panel";
		qcom,mdss-dsi-panel-type = "dsi_cmd_mode";
		qcom,cont-splash-enabled;
		qcom,mdss-dsi-panel-framerate = <60>;
		qcom,mdss-dsi-virtual-channel-id = <0>;
		qcom,mdss-dsi-stream = <0>;
		qcom,mdss-dsi-panel-width = <1080>;
		qcom,mdss-dsi-panel-height = <1920>;
		qcom,mdss-dsi-h-front-porch = <120>;
		qcom,mdss-dsi-h-back-porch = <90>;
		qcom,mdss-dsi-h-pulse-width = <20>;
		qcom,mdss-dsi-h-sync-skew = <0>;
		qcom,mdss-dsi-v-front-porch = <20>;
		qcom,mdss-dsi-v-back-porch = <8>;
		qcom,mdss-dsi-v-pulse-width = <2>;
		qcom,mdss-dsi-h-left-border = <0>;
		qcom,mdss-dsi-h-right-border = <0>;
		qcom,mdss-dsi-v-top-border = <0>;
		qcom,mdss-dsi-v-bottom-border = <0>;
		qcom,mdss-dsi-bpp = <24>;
		qcom,mdss-dsi-underflow-color = <0xff>;
		qcom,mdss-dsi-border-color = <0>;
		qcom,mdss-dsi-h-sync-pulse = <0>;
		qcom,mdss-dsi-traffic-mode = "burst_mode";
		qcom,mdss-dsi-bllp-eof-power-mode;
		qcom,mdss-dsi-bllp-power-mode;
		qcom,mdss-dsi-lane-0-state;
		qcom,mdss-dsi-lane-1-state;
		qcom,mdss-dsi-lane-2-state;
		qcom,mdss-dsi-lane-3-state;
		qcom,mdss-dsi-panel-timings = [f3 3a 26 00 6a 6e 2c 3e 2f 03 04 00];
		qcom,mdss-dsi-t-clk-post = <0x02>;
		qcom,mdss-dsi-t-clk-pre = <0x2d>;
		qcom,mdss-dsi-bl-min-level = <10>;
		qcom,mdss-dsi-bl-max-level = <255>;
		qcom,mdss-dsi-dma-trigger = "trigger_sw";
		qcom,mdss-dsi-mdp-trigger = "none";
		qcom,mdss-dsi-on-command = [
			29 01 00 00 00 00 02
			FF 24
			29 01 00 00 00 00 02
			FB 01
			29 01 00 00 00 00 02
			C5 30
			29 01 00 00 00 00 02
			C7 02
			29 01 00 00 00 00 02
			FF 20
			29 01 00 00 00 00 02
			00 01
			29 01 00 00 00 00 02
			01 55
			29 01 00 00 00 00 02
			02 45
			29 01 00 00 00 00 02
			03 55
			29 01 00 00 00 00 02
			05 50
			29 01 00 00 00 00 02
			06 4A
			29 01 00 00 00 00 02
			07 24
			29 01 00 00 00 00 02
			08 0C
			29 01 00 00 00 00 02
			0B 87
			29 01 00 00 00 00 02
			0C 87
			29 01 00 00 00 00 02
			0E B0
			29 01 00 00 00 00 02
			0F B3
			29 01 00 00 00 00 02
			11 22
			29 01 00 00 00 00 02
			12 10
			29 01 00 00 00 00 02
			13 03
			29 01 00 00 00 00 02
			14 4A
			29 01 00 00 00 00 02
			15 12
			29 01 00 00 00 00 02
			17 1E
			29 01 00 00 00 00 02
			30 01
			29 01 00 00 00 00 02
			58 82
			29 01 00 00 00 00 02
			59 00
			29 01 00 00 00 00 02
			5A 02
			29 01 00 00 00 00 02
			5B 00
			29 01 00 00 00 00 02
			5C 82
			29 01 00 00 00 00 02
			5D 80
			29 01 00 00 00 00 02
			5E 02
			29 01 00 00 00 00 02
			5F 00
			29 01 00 00 00 00 02
			72 31
			29 01 00 00 00 00 02
			FB 01
			29 01 00 00 00 00 02
			FF 24
			29 01 00 00 00 00 02
			00 01
			29 01 00 00 00 00 02
			01 0B
			29 01 00 00 00 00 02
			02 0C
			29 01 00 00 00 00 02
			03 89
			29 01 00 00 00 00 02
			04 8A
			29 01 00 00 00 00 02
			05 0F
			29 01 00 00 00 00 02
			06 10
			29 01 00 00 00 00 02
			07 10
			29 01 00 00 00 00 02
			08 1C
			29 01 00 00 00 00 02
			09 00
			29 01 00 00 00 00 02
			0A 00
			29 01 00 00 00 00 02
			0B 00
			29 01 00 00 00 00 02
			0C 00
			29 01 00 00 00 00 02
			0D 13
			29 01 00 00 00 00 02
			0E 15
			29 01 00 00 00 00 02
			0F 17
			29 01 00 00 00 00 02
			10 01
			29 01 00 00 00 00 02
			11 0B
			29 01 00 00 00 00 02
			12 0C
			29 01 00 00 00 00 02
			13 89
			29 01 00 00 00 00 02
			14 8A
			29 01 00 00 00 00 02
			15 0F
			29 01 00 00 00 00 02
			16 10
			29 01 00 00 00 00 02
			17 10
			29 01 00 00 00 00 02
			18 1C
			29 01 00 00 00 00 02
			19 00
			29 01 00 00 00 00 02
			1A 00
			29 01 00 00 00 00 02
			1B 00
			29 01 00 00 00 00 02
			1C 00
			29 01 00 00 00 00 02
			1D 13
			29 01 00 00 00 00 02
			1E 15
			29 01 00 00 00 00 02
			1F 17
			29 01 00 00 00 00 02
			20 00
			29 01 00 00 00 00 02
			21 01
			29 01 00 00 00 00 02
			22 00
			29 01 00 00 00 00 02
			23 40
			29 01 00 00 00 00 02
			24 40
			29 01 00 00 00 00 02
			25 6D
			29 01 00 00 00 00 02
			26 40
			29 01 00 00 00 00 02
			27 40
			29 01 00 00 00 00 02
			BD 20
			29 01 00 00 00 00 02
			B6 21
			29 01 00 00 00 00 02
			B7 22
			29 01 00 00 00 00 02
			B8 07
			29 01 00 00 00 00 02
			B9 07
			29 01 00 00 00 00 02
			C1 6D
			29 01 00 00 00 00 02
			BE 07
			29 01 00 00 00 00 02
			BF 07
			29 01 00 00 00 00 02
			29 D8
			29 01 00 00 00 00 02
			2A 2A
			29 01 00 00 00 00 02
			4B 03
			29 01 00 00 00 00 02
			4C 11
			29 01 00 00 00 00 02
			4D 10
			29 01 00 00 00 00 02
			4E 01
			29 01 00 00 00 00 02
			4F 01
			29 01 00 00 00 00 02
			50 10
			29 01 00 00 00 00 02
			51 00
			29 01 00 00 00 00 02
			52 80
			29 01 00 00 00 00 02
			53 00
			29 01 00 00 00 00 02
			54 07
			29 01 00 00 00 00 02
			55 25
			29 01 00 00 00 00 02
			56 00
			29 01 00 00 00 00 02
			58 07
			29 01 00 00 00 00 02
			5B 43
			29 01 00 00 00 00 02
			5C 00
			29 01 00 00 00 00 02
			5F 73
			29 01 00 00 00 00 02
			60 73
			29 01 00 00 00 00 02
			63 22
			29 01 00 00 00 00 02
			64 00
			29 01 00 00 00 00 02
			67 08
			29 01 00 00 00 00 02
			68 04
			29 01 00 00 00 00 02
			7A 80
			29 01 00 00 00 00 02
			7B 91
			29 01 00 00 00 00 02
			7C D8
			29 01 00 00 00 00 02
			7D 60
			29 01 00 00 00 00 02
			93 06
			29 01 00 00 00 00 02
			94 06
			29 01 00 00 00 00 02
			B3 C0
			29 01 00 00 00 00 02
			B4 00
			29 01 00 00 00 00 02
			B5 00
			29 01 00 00 00 00 02
			8A 33
			29 01 00 00 00 00 02
			8B F0
			29 01 00 00 00 00 02
			9B 0F
			29 01 00 00 00 00 02
			FB 01
			29 01 00 00 00 00 02
			FF 20
			29 01 00 00 00 00 02
			FB 01
			29 01 00 00 00 00 02
			75 00
			29 01 00 00 00 00 02
			76 2E
			29 01 00 00 00 00 02
			77 00
			29 01 00 00 00 00 02
			78 5F
			29 01 00 00 00 00 02
			79 00
			29 01 00 00 00 00 02
			7A 8B
			29 01 00 00 00 00 02
			7B 00
			29 01 00 00 00 00 02
			7C A8
			29 01 00 00 00 00 02
			7D 00
			29 01 00 00 00 00 02
			7E BF
			29 01 00 00 00 00 02
			7F 00
			29 01 00 00 00 00 02
			80 D3
			29 01 00 00 00 00 02
			81 00
			29 01 00 00 00 00 02
			82 E3
			29 01 00 00 00 00 02
			83 00
			29 01 00 00 00 00 02
			84 F2
			29 01 00 00 00 00 02
			85 01
			29 01 00 00 00 00 02
			86 00
			29 01 00 00 00 00 02
			87 01
			29 01 00 00 00 00 02
			88 2C
			29 01 00 00 00 00 02
			89 01
			29 01 00 00 00 00 02
			8A 4F
			29 01 00 00 00 00 02
			8B 01
			29 01 00 00 00 00 02
			8C 86
			29 01 00 00 00 00 02
			8D 01
			29 01 00 00 00 00 02
			8E B1
			29 01 00 00 00 00 02
			8F 01
			29 01 00 00 00 00 02
			90 F4
			29 01 00 00 00 00 02
			91 02
			29 01 00 00 00 00 02
			92 2A
			29 01 00 00 00 00 02
			93 02
			29 01 00 00 00 00 02
			94 2B
			29 01 00 00 00 00 02
			95 02
			29 01 00 00 00 00 02
			96 5E
			29 01 00 00 00 00 02
			97 02
			29 01 00 00 00 00 02
			98 97
			29 01 00 00 00 00 02
			99 02
			29 01 00 00 00 00 02
			9A BC
			29 01 00 00 00 00 02
			9B 02
			29 01 00 00 00 00 02
			9C EE
			29 01 00 00 00 00 02
			9D 03
			29 01 00 00 00 00 02
			9E 11
			29 01 00 00 00 00 02
			9F 03
			29 01 00 00 00 00 02
			A0 3E
			29 01 00 00 00 00 02
			A2 03
			29 01 00 00 00 00 02
			A3 4B
			29 01 00 00 00 00 02
			A4 03
			29 01 00 00 00 00 02
			A5 5A
			29 01 00 00 00 00 02
			A6 03
			29 01 00 00 00 00 02
			A7 6A
			29 01 00 00 00 00 02
			A9 03
			29 01 00 00 00 00 02
			AA 7C
			29 01 00 00 00 00 02
			AB 03
			29 01 00 00 00 00 02
			AC 8F
			29 01 00 00 00 00 02
			AD 03
			29 01 00 00 00 00 02
			AE A3
			29 01 00 00 00 00 02
			AF 03
			29 01 00 00 00 00 02
			B0 B4
			29 01 00 00 00 00 02
			B1 03
			29 01 00 00 00 00 02
			B2 FF
			29 01 00 00 00 00 02
			B3 00
			29 01 00 00 00 00 02
			B4 2E
			29 01 00 00 00 00 02
			B5 00
			29 01 00 00 00 00 02
			B6 5F
			29 01 00 00 00 00 02
			B7 00
			29 01 00 00 00 00 02
			B8 8B
			29 01 00 00 00 00 02
			B9 00
			29 01 00 00 00 00 02
			BA A8
			29 01 00 00 00 00 02
			BB 00
			29 01 00 00 00 00 02
			BC BF
			29 01 00 00 00 00 02
			BD 00
			29 01 00 00 00 00 02
			BE D3
			29 01 00 00 00 00 02
			BF 00
			29 01 00 00 00 00 02
			C0 E3
			29 01 00 00 00 00 02
			C1 00
			29 01 00 00 00 00 02
			C2 F2
			29 01 00 00 00 00 02
			C3 01
			29 01 00 00 00 00 02
			C4 00
			29 01 00 00 00 00 02
			C5 01
			29 01 00 00 00 00 02
			C6 2C
			29 01 00 00 00 00 02
			C7 01
			29 01 00 00 00 00 02
			C8 4F
			29 01 00 00 00 00 02
			C9 01
			29 01 00 00 00 00 02
			CA 86
			29 01 00 00 00 00 02
			CB 01
			29 01 00 00 00 00 02
			CC B1
			29 01 00 00 00 00 02
			CD 01
			29 01 00 00 00 00 02
			CE F4
			29 01 00 00 00 00 02
			CF 02
			29 01 00 00 00 00 02
			D0 2A
			29 01 00 00 00 00 02
			D1 02
			29 01 00 00 00 00 02
			D2 2B
			29 01 00 00 00 00 02
			D3 02
			29 01 00 00 00 00 02
			D4 5E
			29 01 00 00 00 00 02
			D5 02
			29 01 00 00 00 00 02
			D6 97
			29 01 00 00 00 00 02
			D7 02
			29 01 00 00 00 00 02
			D8 BC
			29 01 00 00 00 00 02
			D9 02
			29 01 00 00 00 00 02
			DA EE
			29 01 00 00 00 00 02
			DB 03
			29 01 00 00 00 00 02
			DC 11
			29 01 00 00 00 00 02
			DD 03
			29 01 00 00 00 00 02
			DE 3E
			29 01 00 00 00 00 02
			DF 03
			29 01 00 00 00 00 02
			E0 4B
			29 01 00 00 00 00 02
			E1 03
			29 01 00 00 00 00 02
			E2 5A
			29 01 00 00 00 00 02
			E3 03
			29 01 00 00 00 00 02
			E4 6A
			29 01 00 00 00 00 02
			E5 03
			29 01 00 00 00 00 02
			E6 7C
			29 01 00 00 00 00 02
			E7 03
			29 01 00 00 00 00 02
			E8 8F
			29 01 00 00 00 00 02
			E9 03
			29 01 00 00 00 00 02
			EA A3
			29 01 00 00 00 00 02
			EB 03
			29 01 00 00 00 00 02
			EC B4
			29 01 00 00 00 00 02
			ED 03
			29 01 00 00 00 00 02
			EE FF
			29 01 00 00 00 00 02
			EF 00
			29 01 00 00 00 00 02
			F0 2E
			29 01 00 00 00 00 02
			F1 00
			29 01 00 00 00 00 02
			F2 4A
			29 01 00 00 00 00 02
			F3 00
			29 01 00 00 00 00 02
			F4 6A
			29 01 00 00 00 00 02
			F5 00
			29 01 00 00 00 00 02
			F6 89
			29 01 00 00 00 00 02
			F7 00
			29 01 00 00 00 00 02
			F8 9C
			29 01 00 00 00 00 02
			F9 00
			29 01 00 00 00 00 02
			FA B1
			29 01 00 00 00 00 02
			FF 21
			29 01 00 00 00 00 02
			FB 01
			29 01 00 00 00 00 02
			00 00
			29 01 00 00 00 00 02
			01 B2
			29 01 00 00 00 00 02
			02 00
			29 01 00 00 00 00 02
			03 C0
			29 01 00 00 00 00 02
			04 00
			29 01 00 00 00 00 02
			05 D0
			29 01 00 00 00 00 02
			06 01
			29 01 00 00 00 00 02
			07 01
			29 01 00 00 00 00 02
			08 01
			29 01 00 00 00 00 02
			09 28
			29 01 00 00 00 00 02
			0A 01
			29 01 00 00 00 00 02
			0B 64
			29 01 00 00 00 00 02
			0C 01
			29 01 00 00 00 00 02
			0D 94
			29 01 00 00 00 00 02
			0E 01
			29 01 00 00 00 00 02
			0F DD
			29 01 00 00 00 00 02
			10 02
			29 01 00 00 00 00 02
			11 18
			29 01 00 00 00 00 02
			12 02
			29 01 00 00 00 00 02
			13 1A
			29 01 00 00 00 00 02
			14 02
			29 01 00 00 00 00 02
			15 50
			29 01 00 00 00 00 02
			16 02
			29 01 00 00 00 00 02
			17 8B
			29 01 00 00 00 00 02
			18 02
			29 01 00 00 00 00 02
			19 B1
			29 01 00 00 00 00 02
			1A 02
			29 01 00 00 00 00 02
			1B E6
			29 01 00 00 00 00 02
			1C 03
			29 01 00 00 00 00 02
			1D 0A
			29 01 00 00 00 00 02
			1E 03
			29 01 00 00 00 00 02
			1F 38
			29 01 00 00 00 00 02
			20 03
			29 01 00 00 00 00 02
			21 46
			29 01 00 00 00 00 02
			22 03
			29 01 00 00 00 00 02
			23 55
			29 01 00 00 00 00 02
			24 03
			29 01 00 00 00 00 02
			25 66
			29 01 00 00 00 00 02
			26 03
			29 01 00 00 00 00 02
			27 77
			29 01 00 00 00 00 02
			28 03
			29 01 00 00 00 00 02
			29 8D
			29 01 00 00 00 00 02
			2A 03
			29 01 00 00 00 00 02
			2B 9F
			29 01 00 00 00 00 02
			2D 03
			29 01 00 00 00 00 02
			2F AA
			29 01 00 00 00 00 02
			30 03
			29 01 00 00 00 00 02
			31 FF
			29 01 00 00 00 00 02
			32 00
			29 01 00 00 00 00 02
			33 2E
			29 01 00 00 00 00 02
			34 00
			29 01 00 00 00 00 02
			35 4A
			29 01 00 00 00 00 02
			36 00
			29 01 00 00 00 00 02
			37 6A
			29 01 00 00 00 00 02
			38 00
			29 01 00 00 00 00 02
			39 89
			29 01 00 00 00 00 02
			3A 00
			29 01 00 00 00 00 02
			3B 9C
			29 01 00 00 00 00 02
			3D 00
			29 01 00 00 00 00 02
			3F B1
			29 01 00 00 00 00 02
			40 00
			29 01 00 00 00 00 02
			41 B2
			29 01 00 00 00 00 02
			42 00
			29 01 00 00 00 00 02
			43 C0
			29 01 00 00 00 00 02
			44 00
			29 01 00 00 00 00 02
			45 D0
			29 01 00 00 00 00 02
			46 01
			29 01 00 00 00 00 02
			47 01
			29 01 00 00 00 00 02
			48 01
			29 01 00 00 00 00 02
			49 28
			29 01 00 00 00 00 02
			4A 01
			29 01 00 00 00 00 02
			4B 64
			29 01 00 00 00 00 02
			4C 01
			29 01 00 00 00 00 02
			4D 94
			29 01 00 00 00 00 02
			4E 01
			29 01 00 00 00 00 02
			4F DD
			29 01 00 00 00 00 02
			50 02
			29 01 00 00 00 00 02
			51 18
			29 01 00 00 00 00 02
			52 02
			29 01 00 00 00 00 02
			53 1A
			29 01 00 00 00 00 02
			54 02
			29 01 00 00 00 00 02
			55 50
			29 01 00 00 00 00 02
			56 02
			29 01 00 00 00 00 02
			58 8B
			29 01 00 00 00 00 02
			59 02
			29 01 00 00 00 00 02
			5A B1
			29 01 00 00 00 00 02
			5B 02
			29 01 00 00 00 00 02
			5C E6
			29 01 00 00 00 00 02
			5D 03
			29 01 00 00 00 00 02
			5E 0A
			29 01 00 00 00 00 02
			5F 03
			29 01 00 00 00 00 02
			60 38
			29 01 00 00 00 00 02
			61 03
			29 01 00 00 00 00 02
			62 46
			29 01 00 00 00 00 02
			63 03
			29 01 00 00 00 00 02
			64 55
			29 01 00 00 00 00 02
			65 03
			29 01 00 00 00 00 02
			66 66
			29 01 00 00 00 00 02
			67 03
			29 01 00 00 00 00 02
			68 77
			29 01 00 00 00 00 02
			69 03
			29 01 00 00 00 00 02
			6A 8D
			29 01 00 00 00 00 02
			6B 03
			29 01 00 00 00 00 02
			6C 9F
			29 01 00 00 00 00 02
			6D 03
			29 01 00 00 00 00 02
			6E AA
			29 01 00 00 00 00 02
			6F 03
			29 01 00 00 00 00 02
			70 FF
			29 01 00 00 00 00 02
			71 00
			29 01 00 00 00 00 02
			72 2E
			29 01 00 00 00 00 02
			73 00
			29 01 00 00 00 00 02
			74 41
			29 01 00 00 00 00 02
			75 00
			29 01 00 00 00 00 02
			76 63
			29 01 00 00 00 00 02
			77 00
			29 01 00 00 00 00 02
			78 7D
			29 01 00 00 00 00 02
			79 00
			29 01 00 00 00 00 02
			7A 93
			29 01 00 00 00 00 02
			7B 00
			29 01 00 00 00 00 02
			7C A7
			29 01 00 00 00 00 02
			7D 00
			29 01 00 00 00 00 02
			7E B7
			29 01 00 00 00 00 02
			7F 00
			29 01 00 00 00 00 02
			80 C3
			29 01 00 00 00 00 02
			81 00
			29 01 00 00 00 00 02
			82 BD
			29 01 00 00 00 00 02
			83 00
			29 01 00 00 00 00 02
			84 E8
			29 01 00 00 00 00 02
			85 01
			29 01 00 00 00 00 02
			86 16
			29 01 00 00 00 00 02
			87 01
			29 01 00 00 00 00 02
			88 5A
			29 01 00 00 00 00 02
			89 01
			29 01 00 00 00 00 02
			8A 8D
			29 01 00 00 00 00 02
			8B 01
			29 01 00 00 00 00 02
			8C DB
			29 01 00 00 00 00 02
			8D 02
			29 01 00 00 00 00 02
			8E 18
			29 01 00 00 00 00 02
			8F 02
			29 01 00 00 00 00 02
			90 19
			29 01 00 00 00 00 02
			91 02
			29 01 00 00 00 00 02
			92 4E
			29 01 00 00 00 00 02
			93 02
			29 01 00 00 00 00 02
			94 85
			29 01 00 00 00 00 02
			95 02
			29 01 00 00 00 00 02
			96 AC
			29 01 00 00 00 00 02
			97 02
			29 01 00 00 00 00 02
			98 E0
			29 01 00 00 00 00 02
			99 03
			29 01 00 00 00 00 02
			9A 01
			29 01 00 00 00 00 02
			9B 03
			29 01 00 00 00 00 02
			9C 32
			29 01 00 00 00 00 02
			9D 03
			29 01 00 00 00 00 02
			9E 3E
			29 01 00 00 00 00 02
			9F 03
			29 01 00 00 00 00 02
			A0 50
			29 01 00 00 00 00 02
			A2 03
			29 01 00 00 00 00 02
			A3 5F
			29 01 00 00 00 00 02
			A4 03
			29 01 00 00 00 00 02
			A5 71
			29 01 00 00 00 00 02
			A6 03
			29 01 00 00 00 00 02
			A7 8C
			29 01 00 00 00 00 02
			A9 03
			29 01 00 00 00 00 02
			AA 98
			29 01 00 00 00 00 02
			AB 03
			29 01 00 00 00 00 02
			AC 9D
			29 01 00 00 00 00 02
			AD 03
			29 01 00 00 00 00 02
			AE FF
			29 01 00 00 00 00 02
			AF 00
			29 01 00 00 00 00 02
			B0 2E
			29 01 00 00 00 00 02
			B1 00
			29 01 00 00 00 00 02
			B2 41
			29 01 00 00 00 00 02
			B3 00
			29 01 00 00 00 00 02
			B4 63
			29 01 00 00 00 00 02
			B5 00
			29 01 00 00 00 00 02
			B6 7D
			29 01 00 00 00 00 02
			B7 00
			29 01 00 00 00 00 02
			B8 93
			29 01 00 00 00 00 02
			B9 00
			29 01 00 00 00 00 02
			BA A7
			29 01 00 00 00 00 02
			BB 00
			29 01 00 00 00 00 02
			BC B7
			29 01 00 00 00 00 02
			BD 00
			29 01 00 00 00 00 02
			BE C3
			29 01 00 00 00 00 02
			BF 00
			29 01 00 00 00 00 02
			C0 BD
			29 01 00 00 00 00 02
			C1 00
			29 01 00 00 00 00 02
			C2 E8
			29 01 00 00 00 00 02
			C3 01
			29 01 00 00 00 00 02
			C4 16
			29 01 00 00 00 00 02
			C5 01
			29 01 00 00 00 00 02
			C6 5A
			29 01 00 00 00 00 02
			C7 01
			29 01 00 00 00 00 02
			C8 8D
			29 01 00 00 00 00 02
			C9 01
			29 01 00 00 00 00 02
			CA DB
			29 01 00 00 00 00 02
			CB 02
			29 01 00 00 00 00 02
			CC 18
			29 01 00 00 00 00 02
			CD 02
			29 01 00 00 00 00 02
			CE 19
			29 01 00 00 00 00 02
			CF 02
			29 01 00 00 00 00 02
			D0 4E
			29 01 00 00 00 00 02
			D1 02
			29 01 00 00 00 00 02
			D2 85
			29 01 00 00 00 00 02
			D3 02
			29 01 00 00 00 00 02
			D4 AC
			29 01 00 00 00 00 02
			D5 02
			29 01 00 00 00 00 02
			D6 E0
			29 01 00 00 00 00 02
			D7 03
			29 01 00 00 00 00 02
			D8 01
			29 01 00 00 00 00 02
			D9 03
			29 01 00 00 00 00 02
			DA 32
			29 01 00 00 00 00 02
			DB 03
			29 01 00 00 00 00 02
			DC 3E
			29 01 00 00 00 00 02
			DD 03
			29 01 00 00 00 00 02
			DE 50
			29 01 00 00 00 00 02
			DF 03
			29 01 00 00 00 00 02
			E0 5F
			29 01 00 00 00 00 02
			E1 03
			29 01 00 00 00 00 02
			E2 71
			29 01 00 00 00 00 02
			E3 03
			29 01 00 00 00 00 02
			E4 8C
			29 01 00 00 00 00 02
			E5 03
			29 01 00 00 00 00 02
			E6 98
			29 01 00 00 00 00 02
			E7 03
			29 01 00 00 00 00 02
			E8 9D
			29 01 00 00 00 00 02
			E9 03
			29 01 00 00 00 00 02
			EA FF
			29 01 00 00 00 00 02
			FF 10
			29 01 00 00 00 00 02
			FB 01
			29 01 00 00 00 00 02
			35 00
			29 01 00 00 00 00 03
			44 05 00
			29 01 00 00 00 00 04
			3B 03 06 06
			29 01 00 00 00 00 02
			BB 10
			29 01 00 00 00 00 02
			35 00
			05 01 00 00 78 00 02
			11 00
			05 01 00 00 00 00 02
			29 00
			];
		qcom,mdss-dsi-off-command = [
			05 01 00 00 32 00 02
			28 00
			05 01 00 00 78 00 02
			10 00
			/*29 01 00 00 00 00 02
			4F 01
			29 01 00 00 00 00 02
			FF 24
			29 01 00 00 00 00 02
			FB 01
			29 01 00 00 00 00 02
			6E 10*/
					];
		qcom,mdss-dsi-on-command-state = "dsi_lp_mode";
		qcom,mdss-dsi-off-command-state = "dsi_lp_mode";

		//cmd mode : set TE
		qcom,mdss-dsi-te-pin-select = <1>;
		qcom,mdss-dsi-te-dcs-command = <1>;
		qcom,mdss-dsi-te-check-enable;
		qcom,mdss-dsi-te-using-te-pin;
		qcom,mdss-dsi-bl-pmic-control-type = "bl_ctrl_pwm";
		qcom,mdss-dsi-bl-pmic-pwm-frequency = <100>;
		qcom,mdss-dsi-bl-pmic-bank-select = <0>;
		qcom,mdss-dsi-pwm-gpio = <&pm8950_mpps 4 0>;
		qcom,mdss-dsi-reset-sequence = <1 20>, <0 10>, <1 20>;
		qcom,mdss-dsi-tx-eot-append;
		qcom,panel-supply-entries = <&dsi_panel_pwr_supply>;

		//add lcd esd
		qcom,mdss-dsi-panel-status-command = [06 01 00 01 05 00 02 0A 08];
		qcom,mdss-dsi-panel-status-command-state = "dsi_lp_mode";
		qcom,mdss-dsi-panel-status-check-mode = "reg_read";
		qcom,mdss-dsi-panel-status-value = <0x9c>;
		qcom,esd-check-enabled;
		//esd end
	};
};
