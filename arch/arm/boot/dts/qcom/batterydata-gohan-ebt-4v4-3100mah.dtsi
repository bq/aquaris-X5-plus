/* Copyright (c) 2016, The Linux Foundation. All rights reserved.
 *
 * This program is free software; you can redistribute it and/or modify
 * it under the terms of the GNU General Public License version 2 and
 * only version 2 as published by the Free Software Foundation.
 *
 * This program is distributed in the hope that it will be useful,
 * but WITHOUT ANY WARRANTY; without even the implied warranty of
 * MERCHANTABILITY or FITNESS FOR A PARTICULAR PURPOSE.  See the
 * GNU General Public License for more details.
 */

qcom,gohan_ebt_3100mah {
	/* #2317866_ebt_gohan_3100mAh_averaged_MasterSlave_Feb16th2016*/
	qcom,max-voltage-uv = <4400000>;
	qcom,nom-batt-capacity-mah = <3100>;
	qcom,batt-id-kohm = <100>;
	qcom,battery-beta = <3380>;
	qcom,battery-type = "gohan_ebt_3100mah_feb16th2016";
	qcom,chg-rslow-comp-c1 = <3725267>;
	qcom,chg-rslow-comp-c2 = <5418268>;
	qcom,chg-rs-to-rslow = <953696>;
	qcom,chg-rslow-comp-thr = <0xA8>;
	qcom,checksum = <0xDC99>;
	qcom,thermal-coefficients = [DA 86 F0 50 08 3C];
	qcom,gui-version = "PMI8950GUI - 2.0.0.15";
	qcom,fg-profile-data = [
		 DE 83 BF 7C
		 1D 81 77 77
		 69 83 DA 75
		 51 8A 11 95
		 F5 81 B5 9A
		 55 BD A9 C9
		 52 12 05 88
		 DD 7D DE 81
		 67 7C 58 83
		 AE 61 91 80
		 A3 8C 41 82
		 FD 99 4F BD
		 65 CA 59 0E
		 BD 0C 75 60
		 14 70 9F FD
		 A3 27 87 44
		 CF 30 00 00
		 68 4C 98 2C
		 1A 43 00 00
		 00 00 00 00
		 00 00 00 00
		 37 70 B4 69
		 DC 7D A8 88
		 51 7D A6 72
		 95 66 B1 80
		 D3 76 B1 6A
		 CF 6F 15 A8
		 23 61 61 98
		 5F A0 71 0C
		 28 00 FF 36
		 F0 11 30 03
		 00 00 00 0C
	];
};
